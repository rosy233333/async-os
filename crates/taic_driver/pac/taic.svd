# TAIC register map
File version: 0.0
Multiple-object-interaction interrupt controller description.
Registers are 64-bit, read-write, reset 0x0 unless marked. A register's access mark holds for its fields unless they carry their own. Offsets are from the block's base; lines under a group give offsets from that group; [hi:lo] are bit positions; {n}, {i} and the like mark numbered series; 'fields as' and 'values as' point back to an identical list; <NAME> marks a mode.

## Memory map
0x01000000 TAIC size 0x1000000 — Multiple-object-interaction interrupt controller description.

## TAIC — Multiple-object-interaction interrupt controller description.
Base 0x01000000
{0x0+0x1000*i} hart{i} (i=0..255) group — Related registers of one hart
  0x00 add wo — Add task into the priority queue.
  0x08 fetch ro — Fetch a task from the priority queue.
    [64:6] tcb — The pointer of task control block.
  0x10 switch_process
  0x18 switch_os
  0x20 register_recv_task — Register receive task.
  0x28 register_recv_target_os — Register receive target os.
  0x30 register_recv_target_proc — Register receive target process.
  0x38 register_recv_target_task — Register receive target task.
  0x40 register_send_task
  0x48 register_send_target_os
  0x50 register_send_target_proc — Register send target process.
  0x58 register_send_target_task
  0x60 send_intr_os — send interrupt to the target os.
  0x68 send_intr_proc — send interrupt to the target process.
  0x70 send_intr_task — send interrupt to the target task.
  0x78 switch_hypervisor — Switch the the hypervisor.
  0x80 current ro — Get the current task.
    [64:6] tcb — The pointer of task control block.
  0x88 remove — Remove the specific task.
  0x90 status ro — The status register.
    [64:4] ocnt — The online hart of the current os/process.
    [3:0] cause — The cause of interrupt.
  0x98 dump — Dump the information on the specific position.
